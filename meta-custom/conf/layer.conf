## meta-custom/conf/layer.conf
```bitbake
BBPATH .= ":${LAYERDIR}"
BBFILES += "${LAYERDIR}/recipes-*/*/*.bb"
BBFILE_COLLECTIONS += "meta-custom"
BBFILE_PATTERN_meta-custom = "^${LAYERDIR}/"
BBFILE_PRIORITY_meta-custom = "6"
LAYERSERIES_COMPAT_meta-custom = "scarthgap"
```

## meta-safemon/conf/distro/safemon-jetson.conf
```bitbake
# Base on poky
require conf/distro/poky.conf

DISTRO = "safemon-jetson"
DISTRO_NAME = "Safemon Linux Jetson"
DISTRO_VERSION = "0.1"

# Systemd
DISTRO_FEATURES:append = " systemd usrmerge wifi opengl egl wayland pam"
VIRTUAL-RUNTIME_init_manager = "systemd"
VIRTUAL-RUNTIME_initscripts = ""
VIRTUAL-RUNTIME_login_manager = "shadow-base"

# SSH and debug
IMAGE_FEATURES += "ssh-server-openssh"
EXTRA_IMAGE_FEATURES += "debug-tweaks package-management"

# Wi-Fi packages
IMAGE_INSTALL:append = " wpa-supplicant wpa-supplicant-config network-config"

IMAGE_INSTALL:append = " rt-tests"

# Redis
IMAGE_INSTALL:append = " redis hiredis safemon-app"

# CAN support
IMAGE_INSTALL:append = " can-utils vcan"

# Graphics - Wayland/Weston for Jetson (no GBM/Mesa)
IMAGE_INSTALL:append = " libdrm weston"

IMAGE_INSTALL:append = " vim procps lsof strace"

IMAGE_INSTALL:append = " gmp openssl"

IMAGE_INSTALL:append = " grpc protobuf abseil-cpp"

IMAGE_INSTALL:append = " kernel-modules gdb"

IMAGE_INSTALL:append = " nvidia-display-modules"

IMAGE_ROOTFS_SIZE = "2097152"
IMAGE_ROOTFS_EXTRA_SPACE = "524288"
```

## meta-safemon/conf/distro/safemon-qemu.conf
```bitbake
# Base on poky
require conf/distro/poky.conf

DISTRO = "safemon-qemu"
DISTRO_NAME = "Safemon Linux QEMU"
DISTRO_VERSION = "0.1"

# Systemd
DISTRO_FEATURES:append = " systemd usrmerge opengl egl"
VIRTUAL-RUNTIME_init_manager = "systemd"
VIRTUAL-RUNTIME_initscripts = ""
VIRTUAL-RUNTIME_login_manager = "shadow-base"

# SSH and debug
IMAGE_FEATURES += "ssh-server-openssh"
EXTRA_IMAGE_FEATURES += "debug-tweaks package-management"

IMAGE_INSTALL:append = " rt-tests"
# Redis
IMAGE_INSTALL:append = " redis hiredis safemon-app"
# CAN support
IMAGE_INSTALL:append = " can-utils vcan"
# Graphics - Mesa with virgl (virtio-gpu guest driver, no llvmpipe)
IMAGE_INSTALL:append = " libdrm mesa mesa-megadriver"
PACKAGECONFIG:append:pn-mesa = " virgl"
PACKAGECONFIG:remove:pn-mesa = "llvm"

IMAGE_INSTALL:append = " vim procps lsof strace"

IMAGE_INSTALL:append = " gmp openssl"

IMAGE_INSTALL:append = " grpc protobuf"

IMAGE_INSTALL:append = " abseil-cpp"
```

## meta-safemon/conf/distro/safemon.conf
```bitbake
# Base on poky
require conf/distro/poky.conf

DISTRO = "safemon"
DISTRO_NAME = "Safemon Linux"
DISTRO_VERSION = "0.1"


# Systemd
DISTRO_FEATURES:append = " systemd usrmerge wifi"
VIRTUAL-RUNTIME_init_manager = "systemd"
VIRTUAL-RUNTIME_initscripts = ""
VIRTUAL-RUNTIME_login_manager = "shadow-base"

# SSH and debug
IMAGE_FEATURES += "ssh-server-openssh"
EXTRA_IMAGE_FEATURES += "debug-tweaks package-management"

# Wi-Fi firmware license
LICENSE_FLAGS_ACCEPTED = "synaptics-killswitch"

# Wi-Fi packages
IMAGE_INSTALL:append = " wpa-supplicant wpa-supplicant-config network-config linux-firmware-rpidistro-bcm43456"

IMAGE_INSTALL:append = " rt-tests"
# Redis
IMAGE_INSTALL:append = " redis hiredis safemon-app"

# GPU memory
RPI_GPU_MEM = "16"

# Kernel 6.12 with PREEMPT
PREFERRED_VERSION_linux-raspberrypi = "6.12%"
PREFERRED_PROVIDER_virtual/kernel = "linux-raspberrypi"
```

## meta-safemon/conf/layer.conf
```bitbake
BBPATH .= ":${LAYERDIR}"
BBFILES += " \
    ${LAYERDIR}/recipes-*/*/*.bb \
"
BBFILES_DYNAMIC += " \
    raspberrypi:${LAYERDIR}/recipes-bsp/bootfiles/*.bbappend \
    core:${LAYERDIR}/recipes-kernel/linux/*.bbappend \
"
BBFILE_COLLECTIONS += "meta-safemon"
BBFILE_PATTERN_meta-safemon = "^${LAYERDIR}/"
BBFILE_PRIORITY_meta-safemon = "6"
LAYERSERIES_COMPAT_meta-safemon = "scarthgap"
LAYERDEPENDS_meta-safemon = " \
    core \
    yocto \
    openembedded-layer \
    meta-python \
    networking-layer \
"
```
